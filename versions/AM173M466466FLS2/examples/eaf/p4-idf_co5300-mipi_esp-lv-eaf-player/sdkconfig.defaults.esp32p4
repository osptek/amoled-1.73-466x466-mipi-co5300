## versions/AM173M466466FLS2/examples/eaf/p4-idf_co5300-mipi_esp-lv-eaf-player/sdkconfig.defaults.esp32p4
```kconfig
# ESP32-P4 default configuration

CONFIG_IDF_TARGET="esp32p4"
CONFIG_ESPTOOLPY_FLASHMODE_QIO=y
CONFIG_ESPTOOLPY_FLASHSIZE_16MB=y

# Default LCD interface: MIPI DSI
CONFIG_EXAMPLE_LCD_INTERFACE_MIPI_DSI=y

# PSRAM configuration
CONFIG_ESP32P4_SELECTS_REV_LESS_V3=y
CONFIG_SPIRAM=y
CONFIG_SPIRAM_SPEED_200M=y
CONFIG_SPIRAM_XIP_FROM_PSRAM=y
CONFIG_SPIRAM_MEMTEST=n
CONFIG_CACHE_L2_CACHE_256KB=y
CONFIG_CACHE_L2_CACHE_LINE_128B=y

CONFIG_LV_DRAW_SW_DRAW_UNIT_CNT=2

CONFIG_IDF_EXPERIMENTAL_FEATURES=y

# File system bridging (optional)
CONFIG_ESP_LVGL_ADAPTER_ENABLE_FS=y
```
